/*-------------------------------------
스마트 횡단보도 제작 프로젝트
제작자 : 배수한   소속 : 대구소프트웨어고등학교
프로젝트 시작일자 : 5월 17일   짬나는 시간마다 틈틈히 코딩

현재버전 1.0
--패치노트--
5월 28일 1.0 -- 각 부품을 제어하기 위한 예제코드를 모음 

----------------------------------------*/

//신호등
#define term 2000         //신호대기 시간(노란불)
#define cterm 500          //횡단보도 깜빡임 텀
#define crossTime 8000    //횡단보도 시간
#define crossOverTime 4000 //횡단보도 깜빡임 시간
#define lightTime 10000    //차량 신호 시간

int cRedPin = 13;    //c는 자동차
int cYellowPin = 12;
int cGreenPin = 11;
int wRedPin = 10; //w는 보행자
int wGreenPin = 9;

int wSwitch = LOW; //깜빡임을 구현하기 위한 스위치


//인체감지센서
int humanPin = 2; //인체감지센서 읽는 핀    
int humanVal = 0; //인체감지센서 값


//timer
unsigned long stTime = 0;
unsigned long edTime = 0;


//음석출력
#include "talkie.h"
Talkie voice;
//신호가 초록불일때 건너세요 음성 값을 계산한 것
const uint8_t cSound[] PROGMEM ={0x00, 0x08, 0x68, 0xc2, 0x93, 0x01, 0xcb, 0x9a, 0x5a, 0xc0, 0x00, 0x3b, 0x84,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 0xf0, 0xff};


//Delay, 사람인식
void cDelay(int delayTime){
  unsigned long retTime = (unsigned long)millis(); //시작시간
  unsigned long nowTime = retTime;

  while(nowTime - retTime <= delayTime){   //중간시간 - 시작시간을 뺀값이 원하는 시간보다 크면 탈출
    humanVal = digitalRead(humanPin);

    if(humanVal == HIGH){
      //빨간불입니다 횡단 금지 
      Serial.println("사람인식");
      voice.say(cSound);
    }
    else{
      //할게 없다
    }
     
    
    delay(50);
    nowTime = (unsigned long)millis();  //중간시간 체크
  }

}


//보행자 신호등 Delay, 사람있는 것 인식
bool wDelay(int delayTime){
  unsigned long retTime = (unsigned long)millis();
  unsigned long nowTime = retTime;
  long b = 0;
  while(nowTime - retTime <= delayTime){
    //동작

    humanVal = digitalRead(humanPin);


    if(humanVal > 0){
      b++;
    }
    nowTime = (unsigned long)millis();
  }

  return (b > 0); //한번이라도 인식을 했으면 true
}



void setup() {
  
  pinMode(cRedPin, OUTPUT);
  pinMode(cYellowPin, OUTPUT);
  pinMode(cGreenPin, OUTPUT);
  pinMode(wRedPin, OUTPUT);
  pinMode(wGreenPin, OUTPUT);
  
  
  pinMode(humanPin, INPUT);

  Serial.begin(9600);
  
}



void loop() {


  //차량 초록불
  digitalWrite(cRedPin,LOW);
  digitalWrite(wGreenPin,LOW);
  digitalWrite(wRedPin,HIGH);
  digitalWrite(cGreenPin,HIGH);
  cDelay(lightTime);


  //차량 노란불
  digitalWrite(cGreenPin,LOW);
  digitalWrite(cYellowPin,HIGH);
  cDelay(term);


  //차량 빨간불 
  digitalWrite(cYellowPin,LOW);
  digitalWrite(cRedPin,HIGH);

  //보행자 초록불
  digitalWrite(wRedPin,LOW);
  digitalWrite(wGreenPin,HIGH);
  wDelay(crossTime - crossOverTime);

  
  //초록불 깜빡이기
  for(int i = 0; i < crossTime / cterm || humanVal == HIGH; i++){ 
  //시간이 지나고 횡단보도에 사용자가 없으면 탈출
    
    if(wSwitch == HIGH)
      wSwitch = LOW;
    else
      wSwitch = HIGH;

   
    digitalWrite(wGreenPin,wSwitch);
    humanVal = wDelay(cterm);

    
    Serial.print(i);
    Serial.print(": ");
    Serial.println(humanVal);
    
  }
   

}
